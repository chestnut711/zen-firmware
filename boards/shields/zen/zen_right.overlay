#include "zen.dtsi"
#include <input/processors.dtsi>
#include <dt-bindings/zmk/input_transform.h>

&pointing_listener {
    /* 親の input-processors は snippet に任せる */

    speed {
        layers = <0 1 2 3 5 6>;
        input-processors = <&zip_xy_scaler 2 3>;
        process-next;
    };

    scroller {
        layers = <4>;
        input-processors =
            <&zip_xy_transform (INPUT_TRANSFORM_Y_INVERT)>,
            <&zip_xy_to_scroll_mapper>,
            <&scroll_scaler 10 1>;
        process-next;
    };
};

&zen_transform {
    col-offset = <7>;
};
